## hosts/esp-idf/components/pocketjs_guest/Kconfig
```kconfig
menu "PocketJS guest"

    config POCKETJS_GUEST_HEAP_LIMIT
        int "Default JavaScript heap limit (bytes)"
        range 1 2147483647
        default 4194304
        help
            Default QuickJS heap limit for each guest, in bytes.
            pocketjs_guest_config_defaults() uses this value. The caller can
            override it through config.heap_limit before creating the guest.

            Leave memory for native UI objects, display buffers, other firmware
            components, and allocation overhead. This limits QuickJS memory
            accounting, not total PSRAM usage, and does not change the GC
            trigger threshold.

endmenu
```

## platforms/sifli/Kconfig
```kconfig
menuconfig POCKETJS
    bool "PocketJS runtime and SiFli platform"
    default n
    help
      Link one PocketJS Rust archive and the RT-Thread host hooks. The
      program's main registers each selected driver with its runtime
      instance. Viewport, scale, density and tick rate come from the exported
      profile (pocket_profile.h).

if POCKETJS

config POCKETJS_HEAP_KB
    int "Shared Rust and QuickJS heap in cached PSRAM (KB)"
    default 7168

config POCKETJS_MPU_OVERRIDE
    bool "SF32LB58x MPU table: PSRAM1 cached, PSRAM2 non-cacheable"
    default n
    help
      Replaces the SDK's weak mpu_config. The framebuffers live in PSRAM2;
      marking that window normal non-cacheable at startup lets EPIC and the
      LCD controller read them without cache maintenance. Adding the region
      after the SDK table is live raises DACCVIOL on the first framebuffer
      write. The chip is a compiler define, not a Kconfig symbol: mpu.c
      refuses chips other than SF32LB58x.

config POCKETJS_RUST_FROM_SOURCE
    bool "Build programs/sifli/archive with cargo"
    default n
    help
      Runs cargo for thumbv8m.main-none-eabihf with the toolchain pinned in
      rust-toolchain.toml. Without it, POCKET_RUNTIME_ARCHIVE names a
      prebuilt libpocket_sifli_runtime.a.

config POCKETJS_DISPLAY
    bool "Framebuffer ring over the RT-Thread LCD device"
    default y
    depends on BSP_USING_LCD

config POCKETJS_INPUT_KEYS
    bool "Board keys as PocketJS buttons"
    default y
    depends on RT_USING_PIN

config POCKETJS_INPUT_TOUCH
    bool "Touch contacts"
    default y
    depends on BSP_USING_TOUCHD

config POCKETJS_GUEST_QUICKJS
    bool "Generated QuickJS guest"
    default y
    depends on PKG_USING_QUICKJS

config POCKETJS_QUICKJS_BELLARD
    bool "The SDK's QuickJS is Bellard's engine"
    default y
    depends on POCKETJS_GUEST_QUICKJS
    help
      Selects the JSMallocState allocator and JS_BOOL rejection tracker
      signatures and defines POCKET_QJS_BELLARD for the generated guest.
      Turn off for a QuickJS-NG package.

config POCKETJS_RUNNER
    bool "Runner thread"
    default y

menuconfig POCKETJS_EPIC
    bool "EPIC executor for the PocketJS renderer"
    default y
    depends on BF0_HCPU && !BSP_USING_EPIC
    help
      Owns EPIC_IRQHandler; keep the SDK's drv_epic (BSP_USING_EPIC) and
      LVGL out of the build.

if POCKETJS_EPIC

config POCKETJS_EPIC_MASK_TILE_KB
    int "A8 plane per slot (KB, two slots in SRAM)"
    default 64
    range 4 512

config POCKETJS_EPIC_CPU_TILE_KB
    int "RGB565 fallback tile per slot (KB, two slots in SRAM)"
    default 64
    range 4 512

config POCKETJS_EPIC_MAX_TEXTURES
    int "Registered textures"
    default 32
    range 1 256

config POCKETJS_EPIC_MIN_PIXELS
    int "Smallest rectangle (physical pixels) worth a hardware transaction"
    default 64
    range 1 1048576

config POCKETJS_EPIC_VGLITE
    bool "VG Lite for quads, tinted and portable-layout blits (SF32LB58)"
    default y
    depends on USING_VGLITE
    help
      A second engine for what EPIC cannot run on 58x: four-point texture
      quads, RGB-modulated blits and textures in PocketJS portable layouts.
      A command for the other engine drains the one in use; the profile
      counts the switches.

config POCKETJS_EPIC_VGLITE_POOL_KB
    int "VG Lite contiguous pool in SRAM (KB)"
    default 320
    range 128 1024
    depends on POCKETJS_EPIC_VGLITE

config POCKETJS_EPIC_VGLITE_CMD_KB
    int "VG Lite command buffer (KB, two come from the pool)"
    default 64
    range 16 256
    depends on POCKETJS_EPIC_VGLITE

endif

endif
```

## platforms/zephyr/Kconfig
```kconfig
menuconfig POCKETJS
    bool "PocketJS runtime and platform hooks"
    help
      Link one PocketJS Rust archive and the Zephyr host hooks. Application
      main registers each selected unit with its runtime instance.

if POCKETJS
config POCKETJS_HEAP_SIZE
    int "PocketJS allocation heap size in bytes"
    default 1048576
    range 4096 2147483647
config POCKETJS_DISPLAY
    bool "PocketJS display subsystem adapter"
    depends on DISPLAY
config POCKETJS_INPUT
    bool "PocketJS input subsystem adapter"
    depends on INPUT
config POCKETJS_GUEST_QUICKJS
    bool "Generated QuickJS guest adapter"
    help
      Requires a consumer supplied QuickJS module target. Set
      POCKET_QUICKJS_TARGET and POCKET_QUICKJS_INCLUDE_DIR in CMake.
config POCKETJS_RUST_FROM_SOURCE
    bool "Compile the program's single Rust archive from source"
    help
      POCKET_PROGRAM_MANIFEST and POCKET_PROGRAM_ARCHIVE identify the product
      program crate. Cargo uses the toolchain selected by the product.
endif
```

## tests/esp-idf/examples/smoke/sdkconfig.defaults
```kconfig
CONFIG_ESP_MAIN_TASK_STACK_SIZE=32768
CONFIG_COMPILER_OPTIMIZATION_PERF=y
CONFIG_SPIRAM=y
CONFIG_SPIRAM_USE_MALLOC=y
CONFIG_FREERTOS_HZ=1000
CONFIG_PARTITION_TABLE_CUSTOM=y
CONFIG_PARTITION_TABLE_CUSTOM_FILENAME="partitions.csv"
CONFIG_ESPTOOLPY_FLASHSIZE_8MB=y
```

## tests/fixtures/sdk-idf/sdkconfig.defaults
```kconfig
CONFIG_COMPILER_OPTIMIZATION_SIZE=y
CONFIG_ESP_MAIN_TASK_STACK_SIZE=32768
CONFIG_ESP_SYSTEM_PANIC_PRINT_REBOOT=y
CONFIG_PARTITION_TABLE_SINGLE_APP_LARGE=y
```

## tests/fixtures/zephyr/native_sim/dts/bindings/display/pocketjs,test-display.yaml
```yaml
description: Display subsystem contract test device
compatible: "pocketjs,test-display"
include: display-controller.yaml
```

## tools/packaging/buildroot/Config.in
```kconfig
menu "PocketJS"
source "$BR2_EXTERNAL_POCKETJS_PATH/package/pocketjs/Config.in"
source "$BR2_EXTERNAL_POCKETJS_PATH/package/pocketjs-app/Config.in"
endmenu
```

## tools/packaging/buildroot/package/pocketjs-app/Config.in
```kconfig
config BR2_PACKAGE_POCKETJS_APP
	bool "Install a compiled PocketJS application"
	depends on BR2_PACKAGE_POCKETJS
	help
	  Install the product CI's .pocket file without invoking Bun or an
	  application compiler. Runtime validates its variant/profile on boot.

if BR2_PACKAGE_POCKETJS_APP
config BR2_PACKAGE_POCKETJS_APP_FILE
	string "Compiled .pocket file"
endif
```

## tools/packaging/buildroot/package/pocketjs/Config.in
```kconfig
config BR2_PACKAGE_POCKETJS
	bool "PocketJS Linux KMS/fbdev program"
	depends on BR2_PACKAGE_HOST_RUSTC_TARGET_ARCH_SUPPORTS
	depends on BR2_TOOLCHAIN_HAS_THREADS
	depends on BR2_USE_MMU
	depends on BR2_ENDIAN = "LITTLE"
	depends on BR2_aarch64 || BR2_arm || BR2_x86_64 || BR2_i386
	select BR2_PACKAGE_HOST_RUSTC
	help
	  File-package runtime with DRM/KMS, fbdev fallback, evdev input,
	  QuickJS and the CPU renderer. Requires Rust >= 1.93 (Buildroot
	  2026.08 ships a suitable compiler). Prepare this external tree
	  from the release index with prepare.py before selecting it.

if BR2_PACKAGE_POCKETJS
config BR2_PACKAGE_POCKETJS_PROFILE
	string "Exported profile directory"
	help
	  The directory `pocket host export --out` wrote before application
	  compilation. Its pocket.host.json is checked against the binding
	  generation and must describe this product; its pocket_profile.rs is
	  compiled into the program, which admits packages against those facts.

config BR2_PACKAGE_POCKETJS_ALSA
	bool "ALSA PCM component"
	select BR2_PACKAGE_ALSA_LIB
	help
	  Add the optional ALSA PCM dependency and --pcm-test diagnostic.
	  This option does not change the exported product profile.

config BR2_PACKAGE_POCKETJS_PROGRAM
	string "Program crate within the release workspace"
	default "pocket-linux-kms"
	help
	  Product source distributions may select their own program crate.
	  The crate must produce a binary of the same name.
endif
```
